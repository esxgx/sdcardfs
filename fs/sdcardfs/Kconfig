## fs/sdcardfs/Kconfig
```kconfig
config SDCARD_FS
	tristate "Sdcardfs file system support"
	depends on CONFIGFS_FS
	default n
	help
	  Sdcardfs is based on Wrapfs file system.

config SDCARD_FS_FADV_NOACTIVE
	bool "Sdcardfs fadvise noactive support"
	depends on (FADV_NOACTIVE && SDCARD_FS)
	default y
	help
	  Sdcardfs supports fadvise noactive mode.

config SDCARD_FS_CASE_INSENSITIVE
	bool "Sdcardfs case-insensitive hierarchy support"
	depends on SDCARD_FS
	default y
	help
	  Sdcardfs uses case-insensitive hierarchy (should be enabled)

config SDCARD_FS_RESERVED_SPACE
	bool "Sdcardfs reserved space support for userdata"
	depends on SDCARD_FS
	default y
	help
          Leave some sdcardfs space to avoid userdata disk full

config SDCARD_FS_XATTR
	bool "Sdcardfs xattr pass-through support"
	depends on SDCARD_FS
	default y
	help
	  Sdcardfs supports extended file attributes pass-through

config SDCARD_FS_SYSFS
	bool "Sdcardfs sysfs support"
	depends on SDCARD_FS
	default n

config SDCARD_FS_PLUGIN_PRIVACY_SPACE
	bool "Sdcardfs privacy space plugin"
	depends on (SDCARD_FS && SDCARD_FS_SYSFS)
	default n
```
